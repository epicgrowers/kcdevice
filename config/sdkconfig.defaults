## config/sdkconfig.defaults
```kconfig
# Bluetooth configuration (based on ESP-IDF v5.5 examples)
CONFIG_BT_ENABLED=y
CONFIG_BT_BLE_42_FEATURES_SUPPORTED=y

# WiFi configuration
CONFIG_ESP_WIFI_AUTH_WPA2_PSK=y

# NVS Storage
# NVS encryption enabled for secure credential storage
CONFIG_NVS_ENCRYPTION=y
CONFIG_NVS_SEC_KEY_PROTECTION_SCHEME=y
CONFIG_NVS_SEC_KEY_PROTECT_USING_FLASH_ENC=n
CONFIG_NVS_SEC_KEY_PROTECT_USING_HMAC=y

# FreeRTOS
CONFIG_FREERTOS_HZ=1000
CONFIG_FREERTOS_USE_TRACE_FACILITY=y
CONFIG_FREERTOS_GENERATE_RUN_TIME_STATS=y
CONFIG_FREERTOS_RUN_TIME_STATS_USING_ESP_TIMER=y

# Flash size
CONFIG_ESPTOOLPY_FLASHSIZE_4MB=y

# Partition table
CONFIG_PARTITION_TABLE_CUSTOM=y
CONFIG_PARTITION_TABLE_CUSTOM_FILENAME="partitions.csv"

# FATFS
CONFIG_FATFS_LFN_STACK=y

# SD logger (ESP32-S3 dashboard build)
CONFIG_KC_SD_LOGGER_ENABLED=y
CONFIG_KC_SD_LOG_INTERVAL_SEC=60
CONFIG_KC_SD_SPI_HOST=2
CONFIG_KC_SD_SPI_MAX_FREQ_KHZ=12000
CONFIG_KC_SD_SPI_MISO_GPIO=13
CONFIG_KC_SD_SPI_MOSI_GPIO=11
CONFIG_KC_SD_SPI_CLK_GPIO=12
CONFIG_KC_SD_SPI_CS_GPIO=10
CONFIG_KC_SD_CARD_DETECT_GPIO=-1
CONFIG_KC_SD_CARD_DETECT_ACTIVE_LOW=y

# Log levels
CONFIG_LOG_DEFAULT_LEVEL_INFO=y
CONFIG_LOG_MAXIMUM_LEVEL_VERBOSE=y

# Flash Encryption - DISABLED for development flexibility
# Keeping flash unencrypted allows unlimited reflashing during development
# NVS encryption alone provides MEDIUM security for WiFi credentials
# Uncomment below to enable (WARNING: IRREVERSIBLE, limits reflashing)
# CONFIG_SECURE_FLASH_ENC_ENABLED=y
# CONFIG_SECURE_FLASH_ENCRYPTION_MODE_DEVELOPMENT=y
# CONFIG_SECURE_FLASH_REQUIRE_ALREADY_ENABLED=n
CONFIG_SECURE_FLASH_UART_BOOTLOADER_ALLOW_ENC=y
CONFIG_SECURE_FLASH_UART_BOOTLOADER_ALLOW_DEC=y
CONFIG_SECURE_FLASH_UART_BOOTLOADER_ALLOW_CACHE=y

# ESP32-S3 specific
CONFIG_IDF_TARGET="esp32s3"
```

## main/Kconfig.projbuild
```kconfig
menu "KC Device Options"

config KC_SD_LOGGER_ENABLED
    bool "Enable SD card sensor logging"
    default y if IDF_TARGET_ESP32S3
    default n
    help
        Enable the background task that writes sensor snapshots to an SD card
        using the SDSPI host driver. This feature is intended for the ESP32-S3
        dashboard build where a microSD slot is wired to the FSPI pins.

config KC_SD_LOG_INTERVAL_SEC
    int "SD log interval (seconds)"
    depends on KC_SD_LOGGER_ENABLED
    range 5 3600
    default 60
    help
        Sampling interval for writing sensor cache snapshots to disk. Each entry
        is written as a newline-delimited JSON document. Values below 5 seconds
        are clamped to 5 seconds at runtime.

config KC_SD_SPI_HOST
    int "SDSPI host (2 = FSPI, 3 = HSPI)"
    depends on KC_SD_LOGGER_ENABLED
    range 1 3
    default 2 if IDF_TARGET_ESP32S3
    default 2
    help
        Select which SPI host is reserved for the SD card. ESP32-S3 boards
        typically wire the SD slot to FSPI (host 2). ESP32-C6 boards should keep
        the logger disabled unless an external slot is wired up.

config KC_SD_SPI_MAX_FREQ_KHZ
    int "SDSPI clock frequency (kHz)"
    depends on KC_SD_LOGGER_ENABLED
    range 400 32000
    default 12000
    help
        Maximum SPI clock used when talking to the SD card. Lower frequencies
        improve signal integrity on long traces; higher frequencies increase
        throughput.

config KC_SD_SPI_MISO_GPIO
    int "SD card MISO GPIO"
    depends on KC_SD_LOGGER_ENABLED
    range 0 48
    default 13

config KC_SD_SPI_MOSI_GPIO
    int "SD card MOSI GPIO"
    depends on KC_SD_LOGGER_ENABLED
    range 0 48
    default 11

config KC_SD_SPI_CLK_GPIO
    int "SD card CLK GPIO"
    depends on KC_SD_LOGGER_ENABLED
    range 0 48
    default 12

config KC_SD_SPI_CS_GPIO
    int "SD card CS GPIO"
    depends on KC_SD_LOGGER_ENABLED
    range 0 48
    default 10

config KC_SD_CARD_DETECT_GPIO
    int "Card detect GPIO (-1 to disable)"
    depends on KC_SD_LOGGER_ENABLED
    range -1 48
    default -1
    help
        Optional GPIO input wired to the SD slot card-detect switch. Set to -1
        if the board does not expose a detect pin.

config KC_SD_CARD_DETECT_ACTIVE_LOW
    bool "Card detect is active-low"
    depends on KC_SD_LOGGER_ENABLED
    default y
    help
        Set to Y when the card-detect line reads LOW while a card is inserted.
        Leave enabled for most slots; disable when the detect pin is active-high.

endmenu
```
